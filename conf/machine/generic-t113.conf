## conf/machine/generic-t113.conf
```bitbake
#@TYPE: Machine
#@NAME: MangoPi MQ-R T113-S3
#@DESCRIPTION: Machine configuration for the MangoPi MQ-R, based on the Allwinner T113-S3 CPU

require conf/machine/include/sun8i.inc

# KERNEL_DEVICETREE = "sun8i-t113s-mangopi-mq-r-t113.dtb"
# KERNEL_IMAGETYPE = "zImage"

# UBOOT_MACHINE = "mangopi_mq_r_defconfig"

# TODO: Move these to BSP recipes for building boot0, u-boot and kernel
SPL_BINARY = "boot0_sdcard.fex"
TPL_BINARY = "boot_package.fex"
RSC_BINARY = "boot-resource.fex"
ENV_BINARY = "env.fex"
KRN_BINARY = "boot.img"

WKS_FILES ?= "generic-sdcard-image.wks.in"
WKS_FILE_DEPENDS = "prebuilt-bsp"
```
